## boards/arm/tqma117xl/Kconfig.board
```kconfig
#  select SOC_PART_NUMBER_MIMXRT1176DVMAA

config BOARD_TQMA117XL
  bool "TQ TQMa117xL module"
  depends on SOC_MIMXRT1176_CM7
  select SOC_PART_NUMBER_MIMXRT1176CVM8A
```

## boards/arm/tqma117xl/Kconfig.defconfig
```kconfig
if BOARD_TQMA117XL

config BOARD
  default "tqma117xl"

choice CODE_LOCATION
  default CODE_FLEXSPI
endchoice

if FLASH

#config FLASH_MCUX_FLEXSPI_NOR
#  default y

choice FLASH_MCUX_FLEXSPI_XIP_MEM_TARGET
  default FLASH_MCUX_FLEXSPI_XIP_MEM_ITCM
endchoice

endif # FLASH

endif # TQMA117XL
```
